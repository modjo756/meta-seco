## conf/machine/include/seco-imx-base.inc
```bitbake
MACHINE_USES_VIVANTE_KERNEL_DRIVER_MODULE ?= "1"

# Das u-boot settings
UBOOT_MAKE_TARGET = ""
UBOOT_CONFIG ??= "sd"
UBOOT_CONFIG[sd] = "mx6q_SBC_A62_256MBx4_defconfig"

IMAGE_FSTYPES = "wic.bz2"

#add bootscript to boot partition
IMAGE_BOOT_FILES = " bootscript \
                     zImage \
                     imx6q-seco_SBC_A62.dtb \
"

# We use WIC for image creation
do_image_wic[depends] += "virtual/bootloader:do_populate_sysroot"
WKS_FILE = "seco-sdcard.wks" 

# There is no more boot partition so install the needed files to /boot
#MACHINE_ESSENTIAL_EXTRA_RDEPENDS += " kernel-devicetree sbc-bootscript-sd \
#"
```

## conf/machine/secosbca62.conf
```bitbake
#@TYPE: Machine
#@NAME: A62
#@SOC: i.MX6Q
#@DESCRIPTION: Machine configuration for SECO A62 board

require conf/machine/include/imx-base.inc
require conf/machine/include/tune-cortexa9.inc
require conf/machine/include/seco-imx-base.inc

SOC_FAMILY = "mx6:mx6q"
MACHINEOVERRIDES =. "mx6:mx6dl:mx6q:"

#SCMVERSION = "n"
PREFERRED_PROVIDER_u-boot ??= "u-boot-seco"
PREFERRED_PROVIDER_virtual/bootloader ??="u-boot-seco"
PREFERRED_VERSION_u-boot-seco = "2015.04"
EXTRA_IMAGEDEPENDS += "virtual/bootloader u-boot-seco"


do_rootfs[depends] += "sbc-bootscript-sd:do_deploy"
BOOT_SCRIPTS = "bootscript"


PREFERRED_PROVIDER_virtual/kernel_seco-a62-qd-256mbx4 = "linux-seco"
PREFERRED_PROVIDER_virtual/kernel_mx6 = "linux-seco"
PREFERRED_PROVIDER_virtual/kernel_mx6q = "linux-seco"
PREFERRED_PROVIDER_virtual/kernel = "linux-seco"
PREFERRED_VERSION_linux-seco = "4.1.15"


KERNEL_IMAGETYPE = "zImage"

KERNEL_DEVICETREE = "imx6q-seco_SBC_A62.dtb"

MACHINE_USES_VIVANTE_KERNEL_DRIVER_MODULE ?= "1"

SERIAL_CONSOLE = "115200 ttymxc1"

MACHINE_FEATURES += " wifi usbhost alsa"
MACHINE_EXTRA_RRECOMMENDS += " kernel-modules linux-firmware-ralink"
```
